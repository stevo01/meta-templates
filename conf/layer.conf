## conf/layer.conf
```bitbake
# We have a conf and classes directory, add to BBPATH
BBPATH .= ":${LAYERDIR}"

# We have recipes-* directories, add to BBFILES
BBFILES += "${LAYERDIR}/recipes-*/*/*.bb \
            ${LAYERDIR}/recipes-*/*/*.bbappend"

BBFILE_COLLECTIONS += "meta-templates"
BBFILE_PATTERN_meta-templates = "^${LAYERDIR}/"
BBFILE_PRIORITY_meta-templates = "6"

LAYERDEPENDS_meta-templates = "core"
LAYERSERIES_COMPAT_meta-templates = "thud"
```
